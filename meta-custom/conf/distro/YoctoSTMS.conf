## meta-custom/conf/distro/YoctoSTMS.conf
```bitbake
# Inherit base settings from Poky
require conf/distro/poky.conf

# Set your distro metadata
DISTRO = "YoctoSTMS"
DISTRO_NAME = "My Andr Custom Linux Distro"
DISTRO_VERSION = "1.234"

# Remove ptest globally
DISTRO_FEATURES:remove = "ptest"

# Optional: Remove Qt tests and examples globally across Qt6 recipes
PACKAGECONFIG:remove:pn-qtbase = "tests examples"
DISTRO_FEATURES:append = " opengl kms"

IMAGE_INSTALL:append = " \
    qt-hello \
    qtbase \
    qtbase-plugins \
    libegl-mesa \
    libgles2-mesa \
    mesa-megadriver \
    libinput \
    ttf-dejavu-sans \
"
```
